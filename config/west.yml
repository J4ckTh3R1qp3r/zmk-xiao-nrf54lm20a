## config/west.yml
```yaml
manifest:
  remotes:
    - name: framework
      url-base: https://github.com/FrameworkComputer

  projects:
    - name: zmk
      remote: framework
      revision: pr-dahlia-keyboard
      import:
        file: app/west.yml
        name-blocklist:
          - zephyr

    - name: zephyr
      remote: framework
      revision: framework-wireless-boards
      clone-depth: 1
      import:
        name-blocklist:
          - ci-tools
          - hal_altera
          - hal_cypress
          - hal_infineon
          - hal_microchip
          - hal_nxp
          - hal_openisa
          - hal_xtensa
          - hal_st
          - hal_ti
          - loramac-node
          - mcuboot
          - mcumgr
          - net-tools
          - openthread
          - edtt
          - trusted-firmware-m

  self:
    path: config
```
